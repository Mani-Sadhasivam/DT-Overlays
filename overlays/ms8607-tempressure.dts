/*
 * Author: Manivannan Sadhasivam
 * Copyright (c) 2017 Linaro Inc.
 * All rights reserved.
 *
 * Sample device tree overlay for MS8607- Temperature and Pressure sensor
 */

/dts-v1/;
/plugin/;

/ {
     compatible = "qcom,apq8016-sbc", "qcom,apq8016", "qcom,sbc";
    
     fragment@0 {
			target-path = "/soc/i2c@78b6000";
        	__overlay__ {
	    			status = "okay";
					#address-cells = <1>;
					#size-cells = <0>;

            		ms8607: ms8607@76 { //using default addr
                			compatible = "meas,ms8607-temppressure";
                			reg = <0x76>;
            		};
			};
    };
};
